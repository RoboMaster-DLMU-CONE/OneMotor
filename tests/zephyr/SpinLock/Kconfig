## west.yml
```yaml
manifest:
  version: "1.2"

  defaults:
    remote: origin

  remotes:
    - name: zephyrproject-rtos
      url-base: https://github.com/zephyrproject-rtos
    - name: origin
      url-base: https://github.com/RoboMaster-DLMU-CONE

  projects:
    - name: zephyr
      remote: zephyrproject-rtos
      revision: main
      import:
        name-allowlist:
          - cmsis
          - cmsis_6
    - name: OneMotor
      repo-path: OneMotor
      path: modules/lib/onemotor
      revision: main

  self:
    path: modules/lib/onemotor
```

## zephyr/Kconfig
```kconfig
config ONE_MOTOR
    bool "OneMotor library support"
    select CPP
    select REQUIRES_FULL_LIBCPP
    select THREAD_LOCAL_STORAGE
    select CAN
    help
      Enable OneMotor library for motor control.

if ONE_MOTOR

choice STD_CPP
    prompt "C++ Standard"
    depends on CPP
    default STD_CPP20
endchoice

config OM_CAN_MAX_DJI_MOTOR
    int "CAN总线最大大疆电机数"
    default 4
    help
      单条CAN总线上最大能挂载的大疆电机数量，默认回报率（1000hz）情况下不推荐超过4个。

config OM_DJI_MOTOR_SKIP_N_FRAME
    int "DJI 电机跳帧数"
    default 2
    help
      读取DJI电机回报值时跳过 N 帧。增大该值可以减小解算开销，代价是解算精准度降低。设为0时不启用跳帧功能。
module = ONE_MOTOR
module-str = OneMotor
source "subsys/logging/Kconfig.template.log_config"

config OM_DTCM_HEAP_SIZZE
    int "DTCM 内存堆大小"
    default 16384
    help
      定义OneMotor在Zephyr DTCM内存区域上分配的堆大小。这部分内存会被用来存储循环中的热点数据，提升速度。仅在启用了DTCM内存节点的情况下有效，否则会回退到使用默认内存。

endif # ONE_MOTOR
```
